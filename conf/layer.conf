## conf/layer.conf
```bitbake
BBPATH .= ":${LAYERDIR}"

BBFILE_COLLECTIONS        += "qti-avf"
BBFILE_PATTERN_qti-avf := "^${LAYERDIR}/"
BBFILE_PRIORITY_qti-avf = "10"
LAYERSERIES_COMPAT_qti-avf = "kirkstone"
BBFILES += " ${LAYERDIR}/recipes/*/*.bb \
             ${LAYERDIR}/recipes/*/*.bbappend"
```
